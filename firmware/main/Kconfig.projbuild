## firmware/main/Kconfig.projbuild
```kconfig
menu "OffGrid LoRa USB input"
    config OFFGRID_USB_IRQ_RX
        bool "Use interrupt-driven native USB Serial/JTAG receive "
        default y
        help
            Install the ESP-IDF USB Serial/JTAG ring-buffer driver and read
            commands in batches. If disabled, use the last measured-working
            getchar() path with a one-tick idle delay. Does not alter SX1278,
            encryption, or NVS. Select only on ESP32-C3 native USB/JTAG.
endmenu
```
